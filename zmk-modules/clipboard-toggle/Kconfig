## zmk-modules/clipboard-toggle/Kconfig
```kconfig
DT_COMPAT_ZMK_BEHAVIOR_CLIPBOARD_ACTION := zmk,behavior-clipboard-action
DT_COMPAT_ZMK_BEHAVIOR_CLIPBOARD_TOGGLE := zmk,behavior-clipboard-toggle

config ZMK_BEHAVIOR_CLIPBOARD_ACTION
    bool
    default $(dt_compat_enabled,$(DT_COMPAT_ZMK_BEHAVIOR_CLIPBOARD_ACTION))

config ZMK_BEHAVIOR_CLIPBOARD_TOGGLE
    bool
    default $(dt_compat_enabled,$(DT_COMPAT_ZMK_BEHAVIOR_CLIPBOARD_TOGGLE))

config ZMK_WIDGET_CLIPBOARD_STATUS
    bool "Clipboard mode status widget"
    depends on ZMK_DISPLAY
    depends on !ZMK_SPLIT || ZMK_SPLIT_ROLE_CENTRAL
    default y if ZMK_DISPLAY
    select LV_USE_LABEL
```

## zmk-modules/clipboard-toggle/dts/bindings/behaviors/zmk,behavior-clipboard-action.yaml
```yaml
description: Clipboard action that sends mac or win keycode based on global toggle state

compatible: "zmk,behavior-clipboard-action"

include: zero_param.yaml

properties:
  mac-keycode:
    type: int
    required: true
    description: "Encoded keycode to send in Mac mode (e.g. LG(C))"
  win-keycode:
    type: int
    required: true
    description: "Encoded keycode to send in Win mode (e.g. LC(C))"
```

## zmk-modules/clipboard-toggle/dts/bindings/behaviors/zmk,behavior-clipboard-toggle.yaml
```yaml
description: Toggle between Mac and Win clipboard modes

compatible: "zmk,behavior-clipboard-toggle"

include: zero_param.yaml
```
