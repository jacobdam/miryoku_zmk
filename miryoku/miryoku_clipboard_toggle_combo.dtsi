// SPDX-License-Identifier: MIT
// Toggle clipboard mode (Win/Mac) by pressing Redo + Undo simultaneously

/ {
    combos {
        compatible = "zmk,combos";
        combo_clipboard_toggle {
            timeout-ms = <50>;
            key-positions = <6 10>;
            bindings = <&cb_toggle>;
            layers = <4 5 3>;
        };
    };
};
